// SPDX-License-Identifier: GPL-2.0
// Headset microphone check: WCD937x MBHC and mic bias as in curtana's
// Android device tree (LineageOS sm6250 cust-atoll-audio-overlay.dtsi sets
// qcom,cdc-micbias1..3-mv = <2700>; atoll-audio-overlay.dtsi sets
// qcom,msm-mbhc-hphl-swh = <1> and qcom,msm-mbhc-gnd-swh = <1>).
#include "sm7125-xiaomi-curtana-audio3.dts"

/ {
	model = "Xiaomi Redmi Note 9S (Huaxing audio4 test)";
	chosen {
		miatoll,boot-profile = "audio4-ram-only";
	};
};

&wcd937x {
	qcom,micbias1-microvolt = <2700000>;
	qcom,micbias2-microvolt = <2700000>;
	qcom,micbias3-microvolt = <2700000>;
	qcom,hphl-jack-type-normally-closed;
	qcom,ground-jack-type-normally-closed;
};
